/* Copyright (c) 2014, The Linux Foundation. All rights reserved.
*
* This program is free software; you can redistribute it and/or modify
* it under the terms of the GNU General Public License version 2 and
* only version 2 as published by the Free Software Foundation.
*
* This program is distributed in the hope that it will be useful,
* but WITHOUT ANY WARRANTY; without even the implied warranty of
* MERCHANTABILITY or FITNESS FOR A PARTICULAR PURPOSE.  See the
* GNU General Public License for more details.
*/
/*begin, fps, fingerprint config*/
&soc {
    fingerprint_fpsensor {
        compatible = "qcom,fingerprint-fpsensor";
        interrupt-parent = <&tlmm>;
        fp-gpio-reset = <&tlmm 93 0x00>;
        fp-gpio-int = <&tlmm  92 0x00>;
        fp-gpio-power = <&tlmm  27 0x00>;
        status = "okay";
    };
};
/*end, fps, fingerprint config*/
